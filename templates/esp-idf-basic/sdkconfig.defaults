## templates/esp-idf-basic/sdkconfig.defaults
```kconfig
# Default sdkconfig settings for this template
# Override in sdkconfig or menuconfig as needed

# Target: ESP32 (change for other chips)
CONFIG_IDF_TARGET="esp32"

# Serial flasher config
CONFIG_ESPTOOLPY_FLASHSIZE_4MB=y

# Log level: Info (reduce to Warning for production)
CONFIG_LOG_DEFAULT_LEVEL_INFO=y

# FreeRTOS tick rate: 1000 Hz for 1ms resolution
CONFIG_FREERTOS_HZ=1000

# Task watchdog timeout: 10 seconds
CONFIG_ESP_TASK_WDT_TIMEOUT_S=10

# Stack overflow detection
CONFIG_FREERTOS_WATCHPOINT_END_OF_STACK=y

# Compiler stack checking
CONFIG_COMPILER_STACK_CHECK_MODE_NORM=y
CONFIG_COMPILER_STACK_CHECK=y
```

## templates/mqtt-node/main/Kconfig.projbuild
```kconfig
menu "MQTT Telemetry Node Configuration"

    menu "Wi-Fi"
        config WIFI_SSID
            string "Wi-Fi SSID"
            default "myssid"

        config WIFI_PASSWORD
            string "Wi-Fi Password"
            default "mypassword"
    endmenu

    menu "MQTT"
        config MQTT_BROKER_URI
            string "MQTT Broker URI"
            default "mqtt://mqtt.example.com"
            help
                MQTT broker URI. Examples:
                  mqtt://host:1883     (TCP)
                  mqtts://host:8883    (TLS)
                  ws://host:80/mqtt    (WebSocket)
                  wss://host:443/mqtt  (WebSocket TLS)

        config MQTT_TELEMETRY_TOPIC
            string "Telemetry Topic"
            default "device/esp32/telemetry"

        config MQTT_STATUS_TOPIC
            string "Status Topic (LWT)"
            default "device/esp32/status"
    endmenu

    config TELEMETRY_INTERVAL_MS
        int "Telemetry publish interval (ms)"
        default 10000
        range 1000 300000
        help
            How often to publish telemetry data in milliseconds.

endmenu
```

## templates/mqtt-node/sdkconfig.defaults
```kconfig
CONFIG_IDF_TARGET="esp32"
CONFIG_ESPTOOLPY_FLASHSIZE_4MB=y
CONFIG_LOG_DEFAULT_LEVEL_INFO=y
CONFIG_FREERTOS_HZ=1000
CONFIG_ESP_TASK_WDT_TIMEOUT_S=10
CONFIG_FREERTOS_WATCHPOINT_END_OF_STACK=y
CONFIG_ESP_MAIN_TASK_STACK_SIZE=4096
CONFIG_MQTT_TRANSPORT_SSL=y
CONFIG_MQTT_TRANSPORT_WEBSOCKET=y
```

## templates/wifi-station/main/Kconfig.projbuild
```kconfig
menu "Wi-Fi Station Configuration"

    config WIFI_SSID
        string "Wi-Fi SSID"
        default "myssid"
        help
            SSID (network name) to connect to.

    config WIFI_PASSWORD
        string "Wi-Fi Password"
        default "mypassword"
        help
            Wi-Fi password (WPA2). Must be at least 8 characters.

endmenu
```

## templates/wifi-station/sdkconfig.defaults
```kconfig
CONFIG_IDF_TARGET="esp32"
CONFIG_ESPTOOLPY_FLASHSIZE_4MB=y
CONFIG_LOG_DEFAULT_LEVEL_INFO=y
CONFIG_FREERTOS_HZ=1000
CONFIG_ESP_TASK_WDT_TIMEOUT_S=10
CONFIG_FREERTOS_WATCHPOINT_END_OF_STACK=y
CONFIG_COMPILER_STACK_CHECK_MODE_NORM=y
CONFIG_COMPILER_STACK_CHECK=y
CONFIG_ESP_MAIN_TASK_STACK_SIZE=4096
```
